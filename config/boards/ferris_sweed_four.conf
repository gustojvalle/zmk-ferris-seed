## config/boards/ferris_sweed_four.conf
```kconfig
# Uncomment these two line to add support for encoders to your firmware
CONFIG_BT_CTLR_TX_PWR_PLUS_8=y
```

## config/boards/shields/boards/Kconfig.board
```kconfig
config BOARD_NICE_NANO_V2
    bool "seeduino_xiao_ble"
    imply ZMK_POWER_DOMAINS
    imply ZMK_POWER_DOMAINS_DYNAMIC_DEFAULT
    depends on SOC_NRF52840_QIAA
```

## config/boards/shields/ferris_sweed_four/Kconfig.defconfig
```kconfig
if SHIELD_FERRIS_SWEED_FOUR_LEFT

config ZMK_KEYBOARD_NAME
    default "ferris_four"

config ZMK_SPLIT_ROLE_CENTRAL
    default y

endif

if SHIELD_FERRIS_SWEED_FOUR_LEFT || SHIELD_FERRIS_SWEED_FOUR_LEFT

config ZMK_SPLIT
    default y

endif
```

## config/boards/shields/ferris_sweed_four/Kconfig.shield
```kconfig
# Copyright (c) 2022 The ZMK Contributors
# SPDX-License-Identifier: MIT

config SHIELD_FERRIS_SWEED_FOUR_LEFT
    def_bool $(shields_list_contains, ferris_sweed_four_left)

config SHIELD_FERRIS_SWEED_FOUR_RIGHT
    def_bool $(shields_list_contains, ferris_sweed_four_right)
```

## config/boards/shields/fsweed/Kconfig.defconfig
```kconfig
# Copyright (c) 2022 The ZMK Contributors SPDX-License-Identifier: MIT
# Copyright (c) 2020 The ZMK Contributors
# SPDX-License-Identifier: MIT

if SHIELD_9PTIMUS_RIGHT

config ZMK_KEYBOARD_NAME
    default "9ptimus"

config ZMK_SPLIT
    default y

config ZMK_SPLIT_ROLE_CENTRAL
	default y


endif

if SHIELD_9PTIMUS_LEFT

config ZMK_SPLIT
    default y

config ZMK_SPLIT_ROLE_CENTRAL
	default n
    

endif
```

## config/boards/shields/fsweed/Kconfig.shield
```kconfig
# Copyright (c) 2020 The ZMK Contributors
# SPDX-License-Identifier: MIT

config SHIELD_9PTIMUS_LEFT
    def_bool $(shields_list_contains,9ptimus_left)

config SHIELD_9PTIMUS_RIGHT
    def_bool $(shields_list_contains,9ptimus_right)
```

## config/west.yml
```yaml
manifest:
  remotes:
    - name: zmkfirmware
      # url-base: https://github.com/zmkfirmware
      # url-base: https://github.com/infused-kim/zmk-zephyr/commits/v2.5.0%2Bzmk-fixes%2Bkim-fixes 
      url-base: https://github.com/petejohanson
  # projects:
  #   - name: zmk
  #     remote: zmkfirmware
  #     revision: main
  #     import: app/west.yml
  projects:
    - name: zmk
      remote: zmkfirmware
      revision: power/domains-and-device-runtime
      import: app/west.yml
  self:
    path: config
```
